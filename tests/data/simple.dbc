VERSION "1.0"

BU_: ECU1 ECU2

BO_ 100 EngineStatus : 8 ECU1
 SG_ EngineSpeed : 0|16@1+ (0.25,0) [0|16383.75] "rpm"
 SG_ CoolantTemp : 16|8@1+ (1,-40) [-40|215] "°C"

BO_ 200 VehicleSpeed : 4 ECU2
 SG_ Speed : 0|16@1+ (0.1,0) [0|6553.5] "km/h"
