VERSION "1.0"

NS_ :

BS_:

BU_: ECM TCM

CM_ "This is a general comment about the DBC file";
CM_ BU_ ECM "Engine Control Module description";
CM_ BO_ 256 "Engine data message description";
CM_ SG_ 256 RPM "Engine speed in revolutions per minute";
CM_ SG_ 512 Gear "Transmission gear position";

BO_ 256 EngineData : 8 ECM
 SG_ RPM : 0|16@1+ (0.25,0) [0|8000] "rpm" *

BO_ 512 TransmissionData : 8 TCM
 SG_ Gear : 0|8@1+ (1,0) [0|5] "" *
