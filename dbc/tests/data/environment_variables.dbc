VERSION "1.0"

NS_ :

BS_:

BU_: ECM

EV_ SensorVoltage : 0 [ 0 | 20 ] "V" 12.0 1 DUMMY_NODE_VECTOR1 DUMMY_NODE_VECTOR2;
EV_ SensorCurrent : 0 [ -32.768 | 32.767 ] "A" 0.0 2 DUMMY_NODE_VECTOR1 DUMMY_NODE_VECTOR2;
EV_ SensorName : 2 [ 0 | 100 ] "" "" 3 DUMMY_NODE_VECTOR1;

ENVVAR_DATA_ SensorVoltage : 0x00 0x01 0x02 0x03;
EV_DATA_ SensorCurrent : 0x0A 0x0B 0x0C;

BO_ 256 TestMessage : 8 ECM
 SG_ TestSignal : 0|8@1+ (1,0) [0|255] "" *

VAL_ SensorVoltage 0 "Low" 10 "Normal" 20 "High" ;
