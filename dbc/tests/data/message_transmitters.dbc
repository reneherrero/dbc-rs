VERSION "1.0"

NS_ :

BS_:

BU_: ECM TCM BCM

BO_ 256 EngineData : 8 ECM
 SG_ RPM : 0|16@1+ (0.25,0) [0|8000] "rpm" *

BO_ 512 TransmissionData : 8 TCM
 SG_ Gear : 0|8@1+ (1,0) [0|5] "" *

BO_TX_BU_ 256 : ECM;
BO_TX_BU_ 512 : TCM, BCM;
